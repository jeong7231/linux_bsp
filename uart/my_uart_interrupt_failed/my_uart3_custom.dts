/dts-v1/;
/plugin/;

/ {
    compatible = "brcm,bcm2711";

    fragment@0 {
        target-path = "/soc/serial@7e201600";
        __overlay__ {
            status = "okay";
            compatible = "jeong,my-uart3"; 
        };
    };
};
